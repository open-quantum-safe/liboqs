/*
 * Copyright (c) The mlkem-native project authors
 * SPDX-License-Identifier: Apache-2.0 OR ISC OR MIT
 */

/*
 * WARNING: This file is auto-generated from scripts/autogen
 *          in the mlkem-native repository.
 *          Do not modify it directly.
 */

/* Twiddle factors for the PPC64LE inverse NTT.
 * See autogen for details.
 */
    -394, -394, -1175, -1175, -1219, -1219, 885, 885,
    1212, 1212, 1029, 1029, -1607, -1607, -1455, -1455,
    -1179, -1179, 886, 886, 1143, 1143, -554, -554,
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    -1600, -1600, -1600, -1600, -1600, -1600, -1600, -1600,

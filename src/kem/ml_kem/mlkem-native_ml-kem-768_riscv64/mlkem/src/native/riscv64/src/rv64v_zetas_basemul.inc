/*
 * Copyright (c) The mlkem-native project authors
 * SPDX-License-Identifier: Apache-2.0 OR ISC OR MIT
 */

/*
 * WARNING: This file is auto-generated from scripts/autogen
 *          in the mlkem-native repository.
 *          Do not modify it directly.
 */

#include "arith_native_riscv64.h"

const int16_t roots[] = {
    -1044, -1103, -1044, 1103,  -1044, 430,   -1044, -430,  -1044, 555,   -1044,
    -555,  -1044, 843,   -1044, -843,  -1044, -1251, -1044, 1251,  -1044, 871,
    -1044, -871,  -1044, 1550,  -1044, -1550, -1044, 105,   -1044, -105,  -1044,
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    1628,  -1044, -1628,
};

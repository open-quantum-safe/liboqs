/*
 * Copyright (c) The mlkem-native project authors
 * SPDX-License-Identifier: Apache-2.0 OR ISC OR MIT
 */

/*
 * WARNING: This file is auto-generated from scripts/autogen
 *          in the mlkem-native repository.
 *          Do not modify it directly.
 */

/* Twisted twiddle factors for the PPC64LE inverse NTT.
 * See autogen for details.
 */
    -3878, -3878, -11566, -11566, -11999, -11999, 8711, 8711,
    11930, 11930, 10129, 10129, -15818, -15818, -14322, -14322,
    -11605, -11605, 8721, 8721, 11251, 11251, -5453, -5453,
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    -15749, -15749, -15749, -15749, -15749, -15749, -15749, -15749,

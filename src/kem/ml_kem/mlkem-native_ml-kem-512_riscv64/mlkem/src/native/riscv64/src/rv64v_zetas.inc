/*
 * Copyright (c) The mlkem-native project authors
 * SPDX-License-Identifier: Apache-2.0 OR ISC OR MIT
 */

/*
 * WARNING: This file is auto-generated from scripts/autogen
 *          in the mlkem-native repository.
 *          Do not modify it directly.
 */

#include "arith_native_riscv64.h"

const int16_t zeta[] = {
    -1044, -758,  573,   -1325, 1223,  652,   -552,  1015,  -1103, 430,   555,
    843,   -1251, 871,   1550,  105,   -359,  -1517, 264,   383,   -1293, 1491,
    -282,  -1544, 422,   587,   177,   -235,  -291,  -460,  1574,  1653,  1493,
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    -308,  996,   991,   958,   -1460, 1522,  1628,
};

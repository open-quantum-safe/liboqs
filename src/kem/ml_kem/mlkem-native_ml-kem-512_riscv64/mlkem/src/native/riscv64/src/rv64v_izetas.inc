/*
 * Copyright (c) The mlkem-native project authors
 * SPDX-License-Identifier: Apache-2.0 OR ISC OR MIT
 */

/*
 * WARNING: This file is auto-generated from scripts/autogen
 *          in the mlkem-native repository.
 *          Do not modify it directly.
 */

#include "arith_native_riscv64.h"

const int16_t izeta[] = {
    -1044, 758,   1571,  205,   1275,  -677,  1065,  -448,  -1628, -1522, 1460,
    -958,  -991,  -996,  308,   108,   1517,  359,   -411,  1542,  725,   1508,
    -961,  398,   -478,  870,   854,   1510,  -794,  1278,  1530,  1185,  -202,
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    -1550, -871,  1251,  -843,  -555,  -430,  1103,
};

/*
 * Copyright (c) The mlkem-native project authors
 * SPDX-License-Identifier: Apache-2.0 OR ISC OR MIT
 */

/*
 * WARNING: This file is auto-generated from scripts/autogen
 *          in the mlkem-native repository.
 *          Do not modify it directly.
 */

/* Twisted twiddle factors for the PPC64LE forward NTT.
 * See autogen for details.
 */
    -15749, -15749, -15749, -15749, -15749, -15749, -15749, -15749,
    -7373, -7373, -7373, -7373, -7373, -7373, -7373, -7373,
    -394, -394, -394, -394, -394, -394, -394, -394,
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    8711, 8711, -11999, -11999, -11566, -11566, -3878, -3878,

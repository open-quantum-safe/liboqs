{{
	0X3C3CF30C0000C003,
	0X0CCCC3F333C0000C,
	0X03C33F33FCC0C03C,
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	0X3F0FC3F0CCF0C000,
	0X3000FF33CCF0F000
},
{
	0X0C0F0FCF0F0CF330,
	0XF0000FC33C3CCF3C,
	0X3C0F3F00C3C300FC,
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	0XF00F0C3FC003C0FF,
	0X330CCFCC03C0FC33
}},
{{
	0X0F0F0FF0F000000F,
	0X00FFFFFFFF0000F0,
	0XFFFF00FF00000F00,
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	0X00F00F000FF00000,
	0X0000FF0F0000F000
},
{
	0XF0FFFFFFF0F00F00,
	0X00FFF0FFFF0000FF,
	0X00FF00000F0F0FFF,
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	0X0F0FFFF00FFFFFFF,
	0XFFFF0F0FFF0FFF00
}},
{{
	0X00FF0000000000FF,
	0XFFFFFFFFFF00FF00,
	0XFF0000FF00FF0000,
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	0XFF00FF00FF000000,
	0X00FF00FFFF000000
},
{
	0X00FF00FF00FF0000,
	0XFF00FFFF000000FF,
	0X0000FFFF000000FF,
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	0X0000FF00FF00FFFF,
	0XFF0000FFFFFF0000
}},
{{
	0X000000000000FFFF,
	0XFFFFFFFFFFFF0000,
	0X0000000000000000,
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	0XFFFF000000000000,
	0XFFFFFFFF00000000
},
{
	0X0000FFFF00000000,
	0XFFFFFFFF0000FFFF,
	0X00000000FFFFFFFF,
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	0XFFFF0000FFFFFFFF,
	0X0000000000000000
}},
{{
	0X00000000FFFFFFFF,
	0X0000000000000000,
	0XFFFFFFFF00000000,
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	0X0000000000000000,
	0XFFFFFFFF00000000
},
{
	0X0000000000000000,
	0XFFFFFFFFFFFFFFFF,
	0X0000000000000000,
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	0XFFFFFFFFFFFFFFFF,
	0XFFFFFFFF00000000
}}

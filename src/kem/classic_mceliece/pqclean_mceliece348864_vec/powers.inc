{
	0x0F0F0F0FF0F0F0F0,
	0xFFFF0000FFFF0000,
	0x0000000000000000,
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	0x3333CCCC3333CCCC,
	0xAAAAAAAAAAAAAAAA
},
{
	0x0F0F0F0FF0F0F0F0,
	0xFFFF0000FFFF0000,
	0x0000000000000000,
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	0x3333CCCC3333CCCC,
	0xAAAAAAAAAAAAAAAA
},
{
	0x0F0F0F0FF0F0F0F0,
	0x0000FFFF0000FFFF,
	0x0000000000000000,
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	0x3333CCCC3333CCCC,
	0xAAAAAAAAAAAAAAAA
},
{
	0x0F0F0F0FF0F0F0F0,
	0x0000FFFF0000FFFF,
	0x0000000000000000,
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	0x3333CCCC3333CCCC,
	0xAAAAAAAAAAAAAAAA
},
{
	0xF0F0F0F00F0F0F0F,
	0xFFFF0000FFFF0000,
	0x0000000000000000,
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	0x3333CCCC3333CCCC,
	0xAAAAAAAAAAAAAAAA
},
{
	0xF0F0F0F00F0F0F0F,
	0xFFFF0000FFFF0000,
	0x0000000000000000,
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	0x3333CCCC3333CCCC,
	0xAAAAAAAAAAAAAAAA
},
{
	0xF0F0F0F00F0F0F0F,
	0x0000FFFF0000FFFF,
	0x0000000000000000,
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	0x3333CCCC3333CCCC,
	0xAAAAAAAAAAAAAAAA
},
{
	0xF0F0F0F00F0F0F0F,
	0x0000FFFF0000FFFF,
	0x0000000000000000,
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	0x3333CCCC3333CCCC,
	0xAAAAAAAAAAAAAAAA
},
{
	0x0F0F0F0FF0F0F0F0,
	0xFFFF0000FFFF0000,
	0xFFFFFFFFFFFFFFFF,
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	0x3333CCCC3333CCCC,
	0x5555555555555555
},
{
	0x0F0F0F0FF0F0F0F0,
	0xFFFF0000FFFF0000,
	0xFFFFFFFFFFFFFFFF,
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	0x3333CCCC3333CCCC,
	0x5555555555555555
},
{
	0x0F0F0F0FF0F0F0F0,
	0x0000FFFF0000FFFF,
	0xFFFFFFFFFFFFFFFF,
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	0x3333CCCC3333CCCC,
	0x5555555555555555
},
{
	0x0F0F0F0FF0F0F0F0,
	0x0000FFFF0000FFFF,
	0xFFFFFFFFFFFFFFFF,
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	0x3333CCCC3333CCCC,
	0x5555555555555555
},
{
	0xF0F0F0F00F0F0F0F,
	0xFFFF0000FFFF0000,
	0xFFFFFFFFFFFFFFFF,
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	0x3333CCCC3333CCCC,
	0x5555555555555555
},
{
	0xF0F0F0F00F0F0F0F,
	0xFFFF0000FFFF0000,
	0xFFFFFFFFFFFFFFFF,
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	0x3333CCCC3333CCCC,
	0x5555555555555555
},
{
	0xF0F0F0F00F0F0F0F,
	0x0000FFFF0000FFFF,
	0xFFFFFFFFFFFFFFFF,
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	0x3333CCCC3333CCCC,
	0x5555555555555555
},
{
	0xF0F0F0F00F0F0F0F,
	0x0000FFFF0000FFFF,
	0xFFFFFFFFFFFFFFFF,
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	0x3333CCCC3333CCCC,
	0x5555555555555555
},
{
	0x0F0F0F0FF0F0F0F0,
	0xFFFF0000FFFF0000,
	0x0000000000000000,
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	0xCCCC3333CCCC3333,
	0xAAAAAAAAAAAAAAAA
},
{
	0x0F0F0F0FF0F0F0F0,
	0xFFFF0000FFFF0000,
	0x0000000000000000,
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	0xCCCC3333CCCC3333,
	0xAAAAAAAAAAAAAAAA
},
{
	0x0F0F0F0FF0F0F0F0,
	0x0000FFFF0000FFFF,
	0x0000000000000000,
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	0xCCCC3333CCCC3333,
	0xAAAAAAAAAAAAAAAA
},
{
	0x0F0F0F0FF0F0F0F0,
	0x0000FFFF0000FFFF,
	0x0000000000000000,
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	0xCCCC3333CCCC3333,
	0xAAAAAAAAAAAAAAAA
},
{
	0xF0F0F0F00F0F0F0F,
	0xFFFF0000FFFF0000,
	0x0000000000000000,
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	0xCCCC3333CCCC3333,
	0xAAAAAAAAAAAAAAAA
},
{
	0xF0F0F0F00F0F0F0F,
	0xFFFF0000FFFF0000,
	0x0000000000000000,
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	0xCCCC3333CCCC3333,
	0xAAAAAAAAAAAAAAAA
},
{
	0xF0F0F0F00F0F0F0F,
	0x0000FFFF0000FFFF,
	0x0000000000000000,
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	0xCCCC3333CCCC3333,
	0xAAAAAAAAAAAAAAAA
},
{
	0xF0F0F0F00F0F0F0F,
	0x0000FFFF0000FFFF,
	0x0000000000000000,
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	0xCCCC3333CCCC3333,
	0xAAAAAAAAAAAAAAAA
},
{
	0x0F0F0F0FF0F0F0F0,
	0xFFFF0000FFFF0000,
	0xFFFFFFFFFFFFFFFF,
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	0xCCCC3333CCCC3333,
	0x5555555555555555
},
{
	0x0F0F0F0FF0F0F0F0,
	0xFFFF0000FFFF0000,
	0xFFFFFFFFFFFFFFFF,
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	0xCCCC3333CCCC3333,
	0x5555555555555555
},
{
	0x0F0F0F0FF0F0F0F0,
	0x0000FFFF0000FFFF,
	0xFFFFFFFFFFFFFFFF,
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	0xCCCC3333CCCC3333,
	0x5555555555555555
},
{
	0x0F0F0F0FF0F0F0F0,
	0x0000FFFF0000FFFF,
	0xFFFFFFFFFFFFFFFF,
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	0xCCCC3333CCCC3333,
	0x5555555555555555
},
{
	0xF0F0F0F00F0F0F0F,
	0xFFFF0000FFFF0000,
	0xFFFFFFFFFFFFFFFF,
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	0xCCCC3333CCCC3333,
	0x5555555555555555
},
{
	0xF0F0F0F00F0F0F0F,
	0xFFFF0000FFFF0000,
	0xFFFFFFFFFFFFFFFF,
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	0xCCCC3333CCCC3333,
	0x5555555555555555
},
{
	0xF0F0F0F00F0F0F0F,
	0x0000FFFF0000FFFF,
	0xFFFFFFFFFFFFFFFF,
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	0xCCCC3333CCCC3333,
	0x5555555555555555
},
{
	0xF0F0F0F00F0F0F0F,
	0x0000FFFF0000FFFF,
	0xFFFFFFFFFFFFFFFF,
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	0xCCCC3333CCCC3333,
	0x5555555555555555
},
{
	0xF0F0F0F00F0F0F0F,
	0xFFFF0000FFFF0000,
	0x0000000000000000,
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	0x3333CCCC3333CCCC,
	0xAAAAAAAAAAAAAAAA
},
{
	0xF0F0F0F00F0F0F0F,
	0xFFFF0000FFFF0000,
	0x0000000000000000,
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	0x3333CCCC3333CCCC,
	0xAAAAAAAAAAAAAAAA
},
{
	0xF0F0F0F00F0F0F0F,
	0x0000FFFF0000FFFF,
	0x0000000000000000,
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	0x3333CCCC3333CCCC,
	0xAAAAAAAAAAAAAAAA
},
{
	0xF0F0F0F00F0F0F0F,
	0x0000FFFF0000FFFF,
	0x0000000000000000,
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	0x3333CCCC3333CCCC,
	0xAAAAAAAAAAAAAAAA
},
{
	0x0F0F0F0FF0F0F0F0,
	0xFFFF0000FFFF0000,
	0x0000000000000000,
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	0x3333CCCC3333CCCC,
	0xAAAAAAAAAAAAAAAA
},
{
	0x0F0F0F0FF0F0F0F0,
	0xFFFF0000FFFF0000,
	0x0000000000000000,
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	0x3333CCCC3333CCCC,
	0xAAAAAAAAAAAAAAAA
},
{
	0x0F0F0F0FF0F0F0F0,
	0x0000FFFF0000FFFF,
	0x0000000000000000,
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	0x3333CCCC3333CCCC,
	0xAAAAAAAAAAAAAAAA
},
{
	0x0F0F0F0FF0F0F0F0,
	0x0000FFFF0000FFFF,
	0x0000000000000000,
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	0x3333CCCC3333CCCC,
	0xAAAAAAAAAAAAAAAA
},
{
	0xF0F0F0F00F0F0F0F,
	0xFFFF0000FFFF0000,
	0xFFFFFFFFFFFFFFFF,
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	0x3333CCCC3333CCCC,
	0x5555555555555555
},
{
	0xF0F0F0F00F0F0F0F,
	0xFFFF0000FFFF0000,
	0xFFFFFFFFFFFFFFFF,
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	0x3333CCCC3333CCCC,
	0x5555555555555555
},
{
	0xF0F0F0F00F0F0F0F,
	0x0000FFFF0000FFFF,
	0xFFFFFFFFFFFFFFFF,
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	0x3333CCCC3333CCCC,
	0x5555555555555555
},
{
	0xF0F0F0F00F0F0F0F,
	0x0000FFFF0000FFFF,
	0xFFFFFFFFFFFFFFFF,
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	0x3333CCCC3333CCCC,
	0x5555555555555555
},
{
	0x0F0F0F0FF0F0F0F0,
	0xFFFF0000FFFF0000,
	0xFFFFFFFFFFFFFFFF,
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	0x3333CCCC3333CCCC,
	0x5555555555555555
},
{
	0x0F0F0F0FF0F0F0F0,
	0xFFFF0000FFFF0000,
	0xFFFFFFFFFFFFFFFF,
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	0x3333CCCC3333CCCC,
	0x5555555555555555
},
{
	0x0F0F0F0FF0F0F0F0,
	0x0000FFFF0000FFFF,
	0xFFFFFFFFFFFFFFFF,
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	0x3333CCCC3333CCCC,
	0x5555555555555555
},
{
	0x0F0F0F0FF0F0F0F0,
	0x0000FFFF0000FFFF,
	0xFFFFFFFFFFFFFFFF,
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	0x3333CCCC3333CCCC,
	0x5555555555555555
},
{
	0xF0F0F0F00F0F0F0F,
	0xFFFF0000FFFF0000,
	0x0000000000000000,
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	0xCCCC3333CCCC3333,
	0xAAAAAAAAAAAAAAAA
},
{
	0xF0F0F0F00F0F0F0F,
	0xFFFF0000FFFF0000,
	0x0000000000000000,
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	0xCCCC3333CCCC3333,
	0xAAAAAAAAAAAAAAAA
},
{
	0xF0F0F0F00F0F0F0F,
	0x0000FFFF0000FFFF,
	0x0000000000000000,
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	0xCCCC3333CCCC3333,
	0xAAAAAAAAAAAAAAAA
},
{
	0xF0F0F0F00F0F0F0F,
	0x0000FFFF0000FFFF,
	0x0000000000000000,
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	0xCCCC3333CCCC3333,
	0xAAAAAAAAAAAAAAAA
},
{
	0x0F0F0F0FF0F0F0F0,
	0xFFFF0000FFFF0000,
	0x0000000000000000,
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	0xCCCC3333CCCC3333,
	0xAAAAAAAAAAAAAAAA
},
{
	0x0F0F0F0FF0F0F0F0,
	0xFFFF0000FFFF0000,
	0x0000000000000000,
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	0xCCCC3333CCCC3333,
	0xAAAAAAAAAAAAAAAA
},
{
	0x0F0F0F0FF0F0F0F0,
	0x0000FFFF0000FFFF,
	0x0000000000000000,
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	0xCCCC3333CCCC3333,
	0xAAAAAAAAAAAAAAAA
},
{
	0x0F0F0F0FF0F0F0F0,
	0x0000FFFF0000FFFF,
	0x0000000000000000,
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	0xCCCC3333CCCC3333,
	0xAAAAAAAAAAAAAAAA
},
{
	0xF0F0F0F00F0F0F0F,
	0xFFFF0000FFFF0000,
	0xFFFFFFFFFFFFFFFF,
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	0xCCCC3333CCCC3333,
	0x5555555555555555
},
{
	0xF0F0F0F00F0F0F0F,
	0xFFFF0000FFFF0000,
	0xFFFFFFFFFFFFFFFF,
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	0xCCCC3333CCCC3333,
	0x5555555555555555
},
{
	0xF0F0F0F00F0F0F0F,
	0x0000FFFF0000FFFF,
	0xFFFFFFFFFFFFFFFF,
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	0xCCCC3333CCCC3333,
	0x5555555555555555
},
{
	0xF0F0F0F00F0F0F0F,
	0x0000FFFF0000FFFF,
	0xFFFFFFFFFFFFFFFF,
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	0xCCCC3333CCCC3333,
	0x5555555555555555
},
{
	0x0F0F0F0FF0F0F0F0,
	0xFFFF0000FFFF0000,
	0xFFFFFFFFFFFFFFFF,
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	0xCCCC3333CCCC3333,
	0x5555555555555555
},
{
	0x0F0F0F0FF0F0F0F0,
	0xFFFF0000FFFF0000,
	0xFFFFFFFFFFFFFFFF,
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	0xCCCC3333CCCC3333,
	0x5555555555555555
},
{
	0x0F0F0F0FF0F0F0F0,
	0x0000FFFF0000FFFF,
	0xFFFFFFFFFFFFFFFF,
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	0xCCCC3333CCCC3333,
	0x5555555555555555
},
{
	0x0F0F0F0FF0F0F0F0,
	0x0000FFFF0000FFFF,
	0xFFFFFFFFFFFFFFFF,
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	0xCCCC3333CCCC3333,
	0x5555555555555555
}

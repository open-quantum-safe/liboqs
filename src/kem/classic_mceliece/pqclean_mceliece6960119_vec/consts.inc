{
	0x6969969669699696,
	0x9966669966999966,
	0x9966669966999966,
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	0x0FF0F00FF00F0FF0,
	0x5AA55AA5A55AA55A
},
{
	0x6969969669699696,
	0x9966669966999966,
	0x9966669966999966,
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	0x0FF0F00FF00F0FF0,
	0x5AA55AA5A55AA55A
},
{
	0xA55A5AA55AA5A55A,
	0x6969696996969696,
	0x5AA55AA5A55AA55A,
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	0xC33C3CC33CC3C33C,
	0x00FFFF0000FFFF00
},
{
	0xA55A5AA55AA5A55A,
	0x6969696996969696,
	0x5AA55AA5A55AA55A,
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	0xC33C3CC33CC3C33C,
	0xFF0000FFFF0000FF
},
{
	0xFFFFFFFF00000000,
	0xA5A5A5A55A5A5A5A,
	0x0FF0F00FF00F0FF0,
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	0xCCCCCCCCCCCCCCCC,
	0xAAAA55555555AAAA
},
{
	0xFFFFFFFF00000000,
	0xA5A5A5A55A5A5A5A,
	0x0FF0F00FF00F0FF0,
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	0xCCCCCCCCCCCCCCCC,
	0x5555AAAAAAAA5555
},
{
	0xFFFFFFFF00000000,
	0x5A5A5A5AA5A5A5A5,
	0xF00F0FF00FF0F00F,
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	0xCCCCCCCCCCCCCCCC,
	0xAAAA55555555AAAA
},
{
	0xFFFFFFFF00000000,
	0x5A5A5A5AA5A5A5A5,
	0xF00F0FF00FF0F00F,
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	0xCCCCCCCCCCCCCCCC,
	0x5555AAAAAAAA5555
},
{
	0xC33C3CC33CC3C33C,
	0x9966669966999966,
	0x9966996699669966,
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	0xC33CC33CC33CC33C,
	0x6666999999996666
},
{
	0x3CC3C33CC33C3CC3,
	0x6699996699666699,
	0x6699669966996699,
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	0x3CC33CC33CC33CC3,
	0x9999666666669999
},
{
	0xC33C3CC33CC3C33C,
	0x9966669966999966,
	0x6699669966996699,
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	0xC33CC33CC33CC33C,
	0x9999666666669999
},
{
	0x3CC3C33CC33C3CC3,
	0x6699996699666699,
	0x9966996699669966,
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	0x3CC33CC33CC33CC3,
	0x6666999999996666
},
{
	0xC33C3CC33CC3C33C,
	0x6699996699666699,
	0x6699669966996699,
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	0xC33CC33CC33CC33C,
	0x6666999999996666
},
{
	0x3CC3C33CC33C3CC3,
	0x9966669966999966,
	0x9966996699669966,
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	0x3CC33CC33CC33CC3,
	0x9999666666669999
},
{
	0xC33C3CC33CC3C33C,
	0x6699996699666699,
	0x9966996699669966,
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	0xC33CC33CC33CC33C,
	0x9999666666669999
},
{
	0x3CC3C33CC33C3CC3,
	0x9966669966999966,
	0x6699669966996699,
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	0x3CC33CC33CC33CC3,
	0x6666999999996666
},
{
	0x3C3CC3C3C3C33C3C,
	0x55555555AAAAAAAA,
	0xF00FF00F0FF00FF0,
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	0xFF0000FF00FFFF00,
	0x6996699669966996
},
{
	0xC3C33C3C3C3CC3C3,
	0x55555555AAAAAAAA,
	0x0FF00FF0F00FF00F,
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	0x00FFFF00FF0000FF,
	0x9669966996699669
},
{
	0x3C3CC3C3C3C33C3C,
	0x55555555AAAAAAAA,
	0xF00FF00F0FF00FF0,
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	0xFF0000FF00FFFF00,
	0x9669966996699669
},
{
	0xC3C33C3C3C3CC3C3,
	0x55555555AAAAAAAA,
	0x0FF00FF0F00FF00F,
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	0x00FFFF00FF0000FF,
	0x6996699669966996
},
{
	0x3C3CC3C3C3C33C3C,
	0x55555555AAAAAAAA,
	0x0FF00FF0F00FF00F,
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	0xFF0000FF00FFFF00,
	0x6996699669966996
},
{
	0xC3C33C3C3C3CC3C3,
	0x55555555AAAAAAAA,
	0xF00FF00F0FF00FF0,
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	0x00FFFF00FF0000FF,
	0x9669966996699669
},
{
	0x3C3CC3C3C3C33C3C,
	0x55555555AAAAAAAA,
	0x0FF00FF0F00FF00F,
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	0xFF0000FF00FFFF00,
	0x9669966996699669
},
{
	0xC3C33C3C3C3CC3C3,
	0x55555555AAAAAAAA,
	0xF00FF00F0FF00FF0,
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	0x00FFFF00FF0000FF,
	0x6996699669966996
},
{
	0x3C3CC3C3C3C33C3C,
	0xAAAAAAAA55555555,
	0x0FF00FF0F00FF00F,
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	0xFF0000FF00FFFF00,
	0x6996699669966996
},
{
	0xC3C33C3C3C3CC3C3,
	0xAAAAAAAA55555555,
	0xF00FF00F0FF00FF0,
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	0x00FFFF00FF0000FF,
	0x9669966996699669
},
{
	0x3C3CC3C3C3C33C3C,
	0xAAAAAAAA55555555,
	0x0FF00FF0F00FF00F,
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	0xFF0000FF00FFFF00,
	0x9669966996699669
},
{
	0xC3C33C3C3C3CC3C3,
	0xAAAAAAAA55555555,
	0xF00FF00F0FF00FF0,
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	0x00FFFF00FF0000FF,
	0x6996699669966996
},
{
	0x3C3CC3C3C3C33C3C,
	0xAAAAAAAA55555555,
	0xF00FF00F0FF00FF0,
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	0xFF0000FF00FFFF00,
	0x6996699669966996
},
{
	0xC3C33C3C3C3CC3C3,
	0xAAAAAAAA55555555,
	0x0FF00FF0F00FF00F,
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	0x00FFFF00FF0000FF,
	0x9669966996699669
},
{
	0x3C3CC3C3C3C33C3C,
	0xAAAAAAAA55555555,
	0xF00FF00F0FF00FF0,
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	0xFF0000FF00FFFF00,
	0x9669966996699669
},
{
	0xC3C33C3C3C3CC3C3,
	0xAAAAAAAA55555555,
	0x0FF00FF0F00FF00F,
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	0x00FFFF00FF0000FF,
	0x6996699669966996
},
{
	0x3CC3C33C3CC3C33C,
	0xAAAAAAAAAAAAAAAA,
	0xFFFF0000FFFF0000,
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	0xA55A5AA55AA5A55A,
	0x6996966996696996
},
{
	0x3CC3C33C3CC3C33C,
	0xAAAAAAAAAAAAAAAA,
	0xFFFF0000FFFF0000,
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	0xA55A5AA55AA5A55A,
	0x6996966996696996
},
{
	0x3CC3C33C3CC3C33C,
	0xAAAAAAAAAAAAAAAA,
	0xFFFF0000FFFF0000,
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	0xA55A5AA55AA5A55A,
	0x6996966996696996
},
{
	0x3CC3C33C3CC3C33C,
	0xAAAAAAAAAAAAAAAA,
	0xFFFF0000FFFF0000,
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	0xA55A5AA55AA5A55A,
	0x6996966996696996
},
{
	0x3CC3C33C3CC3C33C,
	0xAAAAAAAAAAAAAAAA,
	0xFFFF0000FFFF0000,
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	0xA55A5AA55AA5A55A,
	0x6996966996696996
},
{
	0x3CC3C33C3CC3C33C,
	0xAAAAAAAAAAAAAAAA,
	0xFFFF0000FFFF0000,
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	0xA55A5AA55AA5A55A,
	0x6996966996696996
},
{
	0x3CC3C33C3CC3C33C,
	0xAAAAAAAAAAAAAAAA,
	0xFFFF0000FFFF0000,
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	0xA55A5AA55AA5A55A,
	0x6996966996696996
},
{
	0x3CC3C33C3CC3C33C,
	0xAAAAAAAAAAAAAAAA,
	0xFFFF0000FFFF0000,
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	0xA55A5AA55AA5A55A,
	0x6996966996696996
},
{
	0x3CC3C33C3CC3C33C,
	0xAAAAAAAAAAAAAAAA,
	0x0000FFFF0000FFFF,
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	0xA55A5AA55AA5A55A,
	0x6996966996696996
},
{
	0x3CC3C33C3CC3C33C,
	0xAAAAAAAAAAAAAAAA,
	0x0000FFFF0000FFFF,
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	0xA55A5AA55AA5A55A,
	0x6996966996696996
},
{
	0x3CC3C33C3CC3C33C,
	0xAAAAAAAAAAAAAAAA,
	0x0000FFFF0000FFFF,
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	0xA55A5AA55AA5A55A,
	0x6996966996696996
},
{
	0x3CC3C33C3CC3C33C,
	0xAAAAAAAAAAAAAAAA,
	0x0000FFFF0000FFFF,
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	0xA55A5AA55AA5A55A,
	0x6996966996696996
},
{
	0x3CC3C33C3CC3C33C,
	0xAAAAAAAAAAAAAAAA,
	0x0000FFFF0000FFFF,
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	0xA55A5AA55AA5A55A,
	0x6996966996696996
},
{
	0x3CC3C33C3CC3C33C,
	0xAAAAAAAAAAAAAAAA,
	0x0000FFFF0000FFFF,
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	0xA55A5AA55AA5A55A,
	0x6996966996696996
},
{
	0x3CC3C33C3CC3C33C,
	0xAAAAAAAAAAAAAAAA,
	0x0000FFFF0000FFFF,
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	0xA55A5AA55AA5A55A,
	0x6996966996696996
},
{
	0x3CC3C33C3CC3C33C,
	0xAAAAAAAAAAAAAAAA,
	0x0000FFFF0000FFFF,
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	0xA55A5AA55AA5A55A,
	0x6996966996696996
},
{
	0x3CC3C33C3CC3C33C,
	0x5555555555555555,
	0x0000FFFF0000FFFF,
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	0xA55A5AA55AA5A55A,
	0x6996966996696996
},
{
	0x3CC3C33C3CC3C33C,
	0x5555555555555555,
	0x0000FFFF0000FFFF,
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	0xA55A5AA55AA5A55A,
	0x6996966996696996
},
{
	0x3CC3C33C3CC3C33C,
	0x5555555555555555,
	0x0000FFFF0000FFFF,
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	0xA55A5AA55AA5A55A,
	0x6996966996696996
},
{
	0x3CC3C33C3CC3C33C,
	0x5555555555555555,
	0x0000FFFF0000FFFF,
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	0xA55A5AA55AA5A55A,
	0x6996966996696996
},
{
	0x3CC3C33C3CC3C33C,
	0x5555555555555555,
	0x0000FFFF0000FFFF,
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	0xA55A5AA55AA5A55A,
	0x6996966996696996
},
{
	0x3CC3C33C3CC3C33C,
	0x5555555555555555,
	0x0000FFFF0000FFFF,
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	0xA55A5AA55AA5A55A,
	0x6996966996696996
},
{
	0x3CC3C33C3CC3C33C,
	0x5555555555555555,
	0x0000FFFF0000FFFF,
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	0xA55A5AA55AA5A55A,
	0x6996966996696996
},
{
	0x3CC3C33C3CC3C33C,
	0x5555555555555555,
	0x0000FFFF0000FFFF,
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	0xA55A5AA55AA5A55A,
	0x6996966996696996
},
{
	0x3CC3C33C3CC3C33C,
	0x5555555555555555,
	0xFFFF0000FFFF0000,
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	0xA55A5AA55AA5A55A,
	0x6996966996696996
},
{
	0x3CC3C33C3CC3C33C,
	0x5555555555555555,
	0xFFFF0000FFFF0000,
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	0xA55A5AA55AA5A55A,
	0x6996966996696996
},
{
	0x3CC3C33C3CC3C33C,
	0x5555555555555555,
	0xFFFF0000FFFF0000,
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	0xA55A5AA55AA5A55A,
	0x6996966996696996
},
{
	0x3CC3C33C3CC3C33C,
	0x5555555555555555,
	0xFFFF0000FFFF0000,
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	0xA55A5AA55AA5A55A,
	0x6996966996696996
},
{
	0x3CC3C33C3CC3C33C,
	0x5555555555555555,
	0xFFFF0000FFFF0000,
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	0xA55A5AA55AA5A55A,
	0x6996966996696996
},
{
	0x3CC3C33C3CC3C33C,
	0x5555555555555555,
	0xFFFF0000FFFF0000,
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	0xA55A5AA55AA5A55A,
	0x6996966996696996
},
{
	0x3CC3C33C3CC3C33C,
	0x5555555555555555,
	0xFFFF0000FFFF0000,
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	0xA55A5AA55AA5A55A,
	0x6996966996696996
},
{
	0x3CC3C33C3CC3C33C,
	0x5555555555555555,
	0xFFFF0000FFFF0000,
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	0xA55A5AA55AA5A55A,
	0x6996966996696996
},
{
	0x0000000000000000,
	0x0000000000000000,
	0x0000000000000000,
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	0xCCCCCCCCCCCCCCCC,
	0xAAAAAAAAAAAAAAAA
},
{
	0x0000000000000000,
	0x0000000000000000,
	0x0000000000000000,
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	0xCCCCCCCCCCCCCCCC,
	0xAAAAAAAAAAAAAAAA
},
{
	0x0000000000000000,
	0x0000000000000000,
	0x0000000000000000,
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	0xCCCCCCCCCCCCCCCC,
	0xAAAAAAAAAAAAAAAA
},
{
	0x0000000000000000,
	0x0000000000000000,
	0x0000000000000000,
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	0xCCCCCCCCCCCCCCCC,
	0xAAAAAAAAAAAAAAAA
},
{
	0x0000000000000000,
	0x0000000000000000,
	0x0000000000000000,
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	0xCCCCCCCCCCCCCCCC,
	0xAAAAAAAAAAAAAAAA
},
{
	0x0000000000000000,
	0x0000000000000000,
	0x0000000000000000,
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	0xCCCCCCCCCCCCCCCC,
	0xAAAAAAAAAAAAAAAA
},
{
	0x0000000000000000,
	0x0000000000000000,
	0x0000000000000000,
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	0xCCCCCCCCCCCCCCCC,
	0xAAAAAAAAAAAAAAAA
},
{
	0x0000000000000000,
	0x0000000000000000,
	0x0000000000000000,
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	0xCCCCCCCCCCCCCCCC,
	0xAAAAAAAAAAAAAAAA
},
{
	0x0000000000000000,
	0x0000000000000000,
	0x0000000000000000,
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	0xCCCCCCCCCCCCCCCC,
	0xAAAAAAAAAAAAAAAA
},
{
	0x0000000000000000,
	0x0000000000000000,
	0x0000000000000000,
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	0xCCCCCCCCCCCCCCCC,
	0xAAAAAAAAAAAAAAAA
},
{
	0x0000000000000000,
	0x0000000000000000,
	0x0000000000000000,
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	0xCCCCCCCCCCCCCCCC,
	0xAAAAAAAAAAAAAAAA
},
{
	0x0000000000000000,
	0x0000000000000000,
	0x0000000000000000,
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	0xCCCCCCCCCCCCCCCC,
	0xAAAAAAAAAAAAAAAA
},
{
	0x0000000000000000,
	0x0000000000000000,
	0x0000000000000000,
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	0xCCCCCCCCCCCCCCCC,
	0xAAAAAAAAAAAAAAAA
},
{
	0x0000000000000000,
	0x0000000000000000,
	0x0000000000000000,
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	0xCCCCCCCCCCCCCCCC,
	0xAAAAAAAAAAAAAAAA
},
{
	0x0000000000000000,
	0x0000000000000000,
	0x0000000000000000,
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	0xCCCCCCCCCCCCCCCC,
	0xAAAAAAAAAAAAAAAA
},
{
	0x0000000000000000,
	0x0000000000000000,
	0x0000000000000000,
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	0xCCCCCCCCCCCCCCCC,
	0xAAAAAAAAAAAAAAAA
},
{
	0x0000000000000000,
	0x0000000000000000,
	0xFFFFFFFFFFFFFFFF,
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	0xCCCCCCCCCCCCCCCC,
	0xAAAAAAAAAAAAAAAA
},
{
	0x0000000000000000,
	0x0000000000000000,
	0xFFFFFFFFFFFFFFFF,
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	0xCCCCCCCCCCCCCCCC,
	0xAAAAAAAAAAAAAAAA
},
{
	0x0000000000000000,
	0x0000000000000000,
	0xFFFFFFFFFFFFFFFF,
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	0xCCCCCCCCCCCCCCCC,
	0xAAAAAAAAAAAAAAAA
},
{
	0x0000000000000000,
	0x0000000000000000,
	0xFFFFFFFFFFFFFFFF,
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	0xCCCCCCCCCCCCCCCC,
	0xAAAAAAAAAAAAAAAA
},
{
	0x0000000000000000,
	0x0000000000000000,
	0xFFFFFFFFFFFFFFFF,
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	0xCCCCCCCCCCCCCCCC,
	0xAAAAAAAAAAAAAAAA
},
{
	0x0000000000000000,
	0x0000000000000000,
	0xFFFFFFFFFFFFFFFF,
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	0xCCCCCCCCCCCCCCCC,
	0xAAAAAAAAAAAAAAAA
},
{
	0x0000000000000000,
	0x0000000000000000,
	0xFFFFFFFFFFFFFFFF,
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	0xCCCCCCCCCCCCCCCC,
	0xAAAAAAAAAAAAAAAA
},
{
	0x0000000000000000,
	0x0000000000000000,
	0xFFFFFFFFFFFFFFFF,
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	0xCCCCCCCCCCCCCCCC,
	0xAAAAAAAAAAAAAAAA
},
{
	0x0000000000000000,
	0x0000000000000000,
	0xFFFFFFFFFFFFFFFF,
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	0xCCCCCCCCCCCCCCCC,
	0xAAAAAAAAAAAAAAAA
},
{
	0x0000000000000000,
	0x0000000000000000,
	0xFFFFFFFFFFFFFFFF,
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	0xCCCCCCCCCCCCCCCC,
	0xAAAAAAAAAAAAAAAA
},
{
	0x0000000000000000,
	0x0000000000000000,
	0xFFFFFFFFFFFFFFFF,
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	0xCCCCCCCCCCCCCCCC,
	0xAAAAAAAAAAAAAAAA
},
{
	0x0000000000000000,
	0x0000000000000000,
	0xFFFFFFFFFFFFFFFF,
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	0xCCCCCCCCCCCCCCCC,
	0xAAAAAAAAAAAAAAAA
},
{
	0x0000000000000000,
	0x0000000000000000,
	0xFFFFFFFFFFFFFFFF,
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	0xCCCCCCCCCCCCCCCC,
	0xAAAAAAAAAAAAAAAA
},
{
	0x0000000000000000,
	0x0000000000000000,
	0xFFFFFFFFFFFFFFFF,
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	0xCCCCCCCCCCCCCCCC,
	0xAAAAAAAAAAAAAAAA
},
{
	0x0000000000000000,
	0x0000000000000000,
	0xFFFFFFFFFFFFFFFF,
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	0xCCCCCCCCCCCCCCCC,
	0xAAAAAAAAAAAAAAAA
},
{
	0x0000000000000000,
	0x0000000000000000,
	0xFFFFFFFFFFFFFFFF,
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	0xCCCCCCCCCCCCCCCC,
	0xAAAAAAAAAAAAAAAA
},
{
	0x0000000000000000,
	0xFFFFFFFFFFFFFFFF,
	0x0000000000000000,
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	0xCCCCCCCCCCCCCCCC,
	0xAAAAAAAAAAAAAAAA
},
{
	0x0000000000000000,
	0xFFFFFFFFFFFFFFFF,
	0x0000000000000000,
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	0xCCCCCCCCCCCCCCCC,
	0xAAAAAAAAAAAAAAAA
},
{
	0x0000000000000000,
	0xFFFFFFFFFFFFFFFF,
	0x0000000000000000,
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	0xCCCCCCCCCCCCCCCC,
	0xAAAAAAAAAAAAAAAA
},
{
	0x0000000000000000,
	0xFFFFFFFFFFFFFFFF,
	0x0000000000000000,
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	0xCCCCCCCCCCCCCCCC,
	0xAAAAAAAAAAAAAAAA
},
{
	0x0000000000000000,
	0xFFFFFFFFFFFFFFFF,
	0x0000000000000000,
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	0xCCCCCCCCCCCCCCCC,
	0xAAAAAAAAAAAAAAAA
},
{
	0x0000000000000000,
	0xFFFFFFFFFFFFFFFF,
	0x0000000000000000,
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	0xCCCCCCCCCCCCCCCC,
	0xAAAAAAAAAAAAAAAA
},
{
	0x0000000000000000,
	0xFFFFFFFFFFFFFFFF,
	0x0000000000000000,
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	0xCCCCCCCCCCCCCCCC,
	0xAAAAAAAAAAAAAAAA
},
{
	0x0000000000000000,
	0xFFFFFFFFFFFFFFFF,
	0x0000000000000000,
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	0xCCCCCCCCCCCCCCCC,
	0xAAAAAAAAAAAAAAAA
},
{
	0x0000000000000000,
	0xFFFFFFFFFFFFFFFF,
	0x0000000000000000,
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	0xCCCCCCCCCCCCCCCC,
	0xAAAAAAAAAAAAAAAA
},
{
	0x0000000000000000,
	0xFFFFFFFFFFFFFFFF,
	0x0000000000000000,
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	0xCCCCCCCCCCCCCCCC,
	0xAAAAAAAAAAAAAAAA
},
{
	0x0000000000000000,
	0xFFFFFFFFFFFFFFFF,
	0x0000000000000000,
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	0xCCCCCCCCCCCCCCCC,
	0xAAAAAAAAAAAAAAAA
},
{
	0x0000000000000000,
	0xFFFFFFFFFFFFFFFF,
	0x0000000000000000,
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	0xCCCCCCCCCCCCCCCC,
	0xAAAAAAAAAAAAAAAA
},
{
	0x0000000000000000,
	0xFFFFFFFFFFFFFFFF,
	0x0000000000000000,
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	0xCCCCCCCCCCCCCCCC,
	0xAAAAAAAAAAAAAAAA
},
{
	0x0000000000000000,
	0xFFFFFFFFFFFFFFFF,
	0x0000000000000000,
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	0xCCCCCCCCCCCCCCCC,
	0xAAAAAAAAAAAAAAAA
},
{
	0x0000000000000000,
	0xFFFFFFFFFFFFFFFF,
	0x0000000000000000,
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	0xCCCCCCCCCCCCCCCC,
	0xAAAAAAAAAAAAAAAA
},
{
	0x0000000000000000,
	0xFFFFFFFFFFFFFFFF,
	0x0000000000000000,
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	0xCCCCCCCCCCCCCCCC,
	0xAAAAAAAAAAAAAAAA
},
{
	0x0000000000000000,
	0xFFFFFFFFFFFFFFFF,
	0xFFFFFFFFFFFFFFFF,
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	0xCCCCCCCCCCCCCCCC,
	0xAAAAAAAAAAAAAAAA
},
{
	0x0000000000000000,
	0xFFFFFFFFFFFFFFFF,
	0xFFFFFFFFFFFFFFFF,
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	0xCCCCCCCCCCCCCCCC,
	0xAAAAAAAAAAAAAAAA
},
{
	0x0000000000000000,
	0xFFFFFFFFFFFFFFFF,
	0xFFFFFFFFFFFFFFFF,
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	0xCCCCCCCCCCCCCCCC,
	0xAAAAAAAAAAAAAAAA
},
{
	0x0000000000000000,
	0xFFFFFFFFFFFFFFFF,
	0xFFFFFFFFFFFFFFFF,
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	0xCCCCCCCCCCCCCCCC,
	0xAAAAAAAAAAAAAAAA
},
{
	0x0000000000000000,
	0xFFFFFFFFFFFFFFFF,
	0xFFFFFFFFFFFFFFFF,
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	0xCCCCCCCCCCCCCCCC,
	0xAAAAAAAAAAAAAAAA
},
{
	0x0000000000000000,
	0xFFFFFFFFFFFFFFFF,
	0xFFFFFFFFFFFFFFFF,
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	0xCCCCCCCCCCCCCCCC,
	0xAAAAAAAAAAAAAAAA
},
{
	0x0000000000000000,
	0xFFFFFFFFFFFFFFFF,
	0xFFFFFFFFFFFFFFFF,
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	0xCCCCCCCCCCCCCCCC,
	0xAAAAAAAAAAAAAAAA
},
{
	0x0000000000000000,
	0xFFFFFFFFFFFFFFFF,
	0xFFFFFFFFFFFFFFFF,
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	0xCCCCCCCCCCCCCCCC,
	0xAAAAAAAAAAAAAAAA
},
{
	0x0000000000000000,
	0xFFFFFFFFFFFFFFFF,
	0xFFFFFFFFFFFFFFFF,
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	0xCCCCCCCCCCCCCCCC,
	0xAAAAAAAAAAAAAAAA
},
{
	0x0000000000000000,
	0xFFFFFFFFFFFFFFFF,
	0xFFFFFFFFFFFFFFFF,
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	0xCCCCCCCCCCCCCCCC,
	0xAAAAAAAAAAAAAAAA
},
{
	0x0000000000000000,
	0xFFFFFFFFFFFFFFFF,
	0xFFFFFFFFFFFFFFFF,
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	0xCCCCCCCCCCCCCCCC,
	0xAAAAAAAAAAAAAAAA
},
{
	0x0000000000000000,
	0xFFFFFFFFFFFFFFFF,
	0xFFFFFFFFFFFFFFFF,
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	0xCCCCCCCCCCCCCCCC,
	0xAAAAAAAAAAAAAAAA
},
{
	0x0000000000000000,
	0xFFFFFFFFFFFFFFFF,
	0xFFFFFFFFFFFFFFFF,
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	0xCCCCCCCCCCCCCCCC,
	0xAAAAAAAAAAAAAAAA
},
{
	0x0000000000000000,
	0xFFFFFFFFFFFFFFFF,
	0xFFFFFFFFFFFFFFFF,
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	0xCCCCCCCCCCCCCCCC,
	0xAAAAAAAAAAAAAAAA
},
{
	0x0000000000000000,
	0xFFFFFFFFFFFFFFFF,
	0xFFFFFFFFFFFFFFFF,
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	0xCCCCCCCCCCCCCCCC,
	0xAAAAAAAAAAAAAAAA
},
{
	0x0000000000000000,
	0xFFFFFFFFFFFFFFFF,
	0xFFFFFFFFFFFFFFFF,
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	0xCCCCCCCCCCCCCCCC,
	0xAAAAAAAAAAAAAAAA
},

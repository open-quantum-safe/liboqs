{{
	0x3C3CF30C0000C003,
	0x0CCCC3F333C0000C,
	0x03C33F33FCC0C03C,
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	0x3F0FC3F0CCF0C000,
	0x3000FF33CCF0F000
},
{
	0x0C0F0FCF0F0CF330,
	0xF0000FC33C3CCF3C,
	0x3C0F3F00C3C300FC,
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	0xF00F0C3FC003C0FF,
	0x330CCFCC03C0FC33
},
{
	0xF0F30C33CF03F03F,
	0x00F30FC00C3300FF,
	0xF3CC3CF3F3FCF33F,
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	0x30CFCFC3CC0F3000,
	0x0CF30CCF3FCFCC0F
},
{
	0x3F30CC0C000F3FCC,
	0xFC3CF030FC3FFF03,
	0x33FFFCFF0CCF3CC3,
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	0x003FF0003F00C00C,
	0xCFF3C3033F030FFF
}},
{{
	0x0F0F0FF0F000000F,
	0x00FFFFFFFF0000F0,
	0xFFFF00FF00000F00,
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	0x00F00F000FF00000,
	0x0000FF0F0000F000
},
{
	0xF0FFFFFFF0F00F00,
	0x00FFF0FFFF0000FF,
	0x00FF00000F0F0FFF,
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	0x0F0FFFF00FFFFFFF,
	0xFFFF0F0FFF0FFF00
},
{
	0x0F0F00FF0FF0FFFF,
	0xF000F0F00F00FF0F,
	0x000FFFF0FFF0FF0F,
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	0x00FFF0F0FF000F0F,
	0x000FFFF0000FFF00
},
{
	0xFF0F0F00F000F0FF,
	0x0FFFFFFFFF00000F,
	0xF0FFFF000F00F0FF,
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	0xF0F00000FF00F0F0,
	0x0F0F0FFFFFFFFFFF
}},
{{
	0x00FF0000000000FF,
	0xFFFFFFFFFF00FF00,
	0xFF0000FF00FF0000,
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	0xFF00FF00FF000000,
	0x00FF00FFFF000000
},
{
	0x00FF00FF00FF0000,
	0xFF00FFFF000000FF,
	0x0000FFFF000000FF,
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	0x0000FF00FF00FFFF,
	0xFF0000FFFFFF0000
},
{
	0xFFFF00FF00FF00FF,
	0x00FFFF000000FF00,
	0xFFFF00FFFFFFFF00,
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	0xFFFF00FFFF0000FF,
	0x0000FF00000000FF
},
{
	0xFF0000FFFFFF00FF,
	0xFFFF0000FFFFFFFF,
	0xFFFF000000FFFFFF,
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	0xFFFFFFFFFFFFFFFF,
	0x0000FF000000FFFF
}},
{{
	0x000000000000FFFF,
	0xFFFFFFFFFFFF0000,
	0x0000000000000000,
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	0xFFFF000000000000,
	0xFFFFFFFF00000000
},
{
	0x0000FFFF00000000,
	0xFFFFFFFF0000FFFF,
	0x00000000FFFFFFFF,
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	0xFFFF0000FFFFFFFF,
	0x0000000000000000
},
{
	0xFFFFFFFFFFFFFFFF,
	0xFFFFFFFF00000000,
	0xFFFF000000000000,
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	0xFFFFFFFF0000FFFF,
	0xFFFF0000FFFFFFFF
},
{
	0x0000FFFFFFFFFFFF,
	0x0000FFFF0000FFFF,
	0x0000FFFFFFFF0000,
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	0x0000FFFFFFFF0000,
	0x0000FFFFFFFFFFFF
}},
{{
	0x00000000FFFFFFFF,
	0x0000000000000000,
	0xFFFFFFFF00000000,
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	0x0000000000000000,
	0xFFFFFFFF00000000
},
{
	0x0000000000000000,
	0xFFFFFFFFFFFFFFFF,
	0x0000000000000000,
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	0xFFFFFFFFFFFFFFFF,
	0xFFFFFFFF00000000
},
{
	0x00000000FFFFFFFF,
	0xFFFFFFFF00000000,
	0xFFFFFFFF00000000,
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	0xFFFFFFFFFFFFFFFF,
	0xFFFFFFFFFFFFFFFF
},
{
	0xFFFFFFFFFFFFFFFF,
	0x00000000FFFFFFFF,
	0x0000000000000000,
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	0xFFFFFFFF00000000,
	0xFFFFFFFF00000000
}},
{{
	0xFFFFFFFFFFFFFFFF,
	0x0000000000000000,
	0x0000000000000000,
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	0x0000000000000000,
	0x0000000000000000
},
{
	0x0000000000000000,
	0x0000000000000000,
	0xFFFFFFFFFFFFFFFF,
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	0xFFFFFFFFFFFFFFFF,
	0x0000000000000000
},
{
	0xFFFFFFFFFFFFFFFF,
	0x0000000000000000,
	0xFFFFFFFFFFFFFFFF,
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	0xFFFFFFFFFFFFFFFF,
	0xFFFFFFFFFFFFFFFF
},
{
	0x0000000000000000,
	0xFFFFFFFFFFFFFFFF,
	0x0000000000000000,
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	0x0000000000000000,
	0xFFFFFFFFFFFFFFFF
}},

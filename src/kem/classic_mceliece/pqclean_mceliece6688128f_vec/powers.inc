{
	0x5AA55AA5A55AA55A,
	0x3CC33CC3C33CC33C,
	0xA5A55A5AA5A55A5A,
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	0x0FF00FF00FF00FF0,
	0x0F0FF0F00F0FF0F0
},
{
	0x5AA55AA5A55AA55A,
	0xC33CC33C3CC33CC3,
	0xA5A55A5AA5A55A5A,
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	0xF00FF00FF00FF00F,
	0xF0F00F0FF0F00F0F
},
{
	0xA55AA55A5AA55AA5,
	0xC33CC33C3CC33CC3,
	0xA5A55A5AA5A55A5A,
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	0x0FF00FF00FF00FF0,
	0xF0F00F0FF0F00F0F
},
{
	0xA55AA55A5AA55AA5,
	0x3CC33CC3C33CC33C,
	0xA5A55A5AA5A55A5A,
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	0xF00FF00FF00FF00F,
	0x0F0FF0F00F0FF0F0
},
{
	0xA55AA55A5AA55AA5,
	0x3CC33CC3C33CC33C,
	0xA5A55A5AA5A55A5A,
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	0xF00FF00FF00FF00F,
	0x0F0FF0F00F0FF0F0
},
{
	0xA55AA55A5AA55AA5,
	0xC33CC33C3CC33CC3,
	0xA5A55A5AA5A55A5A,
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	0x0FF00FF00FF00FF0,
	0xF0F00F0FF0F00F0F
},
{
	0x5AA55AA5A55AA55A,
	0xC33CC33C3CC33CC3,
	0xA5A55A5AA5A55A5A,
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	0xF00FF00FF00FF00F,
	0xF0F00F0FF0F00F0F
},
{
	0x5AA55AA5A55AA55A,
	0x3CC33CC3C33CC33C,
	0xA5A55A5AA5A55A5A,
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	0x0FF00FF00FF00FF0,
	0x0F0FF0F00F0FF0F0
},
{
	0x5AA55AA5A55AA55A,
	0xC33CC33C3CC33CC3,
	0xA5A55A5AA5A55A5A,
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	0x0FF00FF00FF00FF0,
	0x0F0FF0F00F0FF0F0
},
{
	0x5AA55AA5A55AA55A,
	0x3CC33CC3C33CC33C,
	0xA5A55A5AA5A55A5A,
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	0xF00FF00FF00FF00F,
	0xF0F00F0FF0F00F0F
},
{
	0xA55AA55A5AA55AA5,
	0x3CC33CC3C33CC33C,
	0xA5A55A5AA5A55A5A,
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	0x0FF00FF00FF00FF0,
	0xF0F00F0FF0F00F0F
},
{
	0xA55AA55A5AA55AA5,
	0xC33CC33C3CC33CC3,
	0xA5A55A5AA5A55A5A,
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	0xF00FF00FF00FF00F,
	0x0F0FF0F00F0FF0F0
},
{
	0xA55AA55A5AA55AA5,
	0xC33CC33C3CC33CC3,
	0xA5A55A5AA5A55A5A,
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	0xF00FF00FF00FF00F,
	0x0F0FF0F00F0FF0F0
},
{
	0xA55AA55A5AA55AA5,
	0x3CC33CC3C33CC33C,
	0xA5A55A5AA5A55A5A,
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	0x0FF00FF00FF00FF0,
	0xF0F00F0FF0F00F0F
},
{
	0x5AA55AA5A55AA55A,
	0x3CC33CC3C33CC33C,
	0xA5A55A5AA5A55A5A,
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	0xF00FF00FF00FF00F,
	0xF0F00F0FF0F00F0F
},
{
	0x5AA55AA5A55AA55A,
	0xC33CC33C3CC33CC3,
	0xA5A55A5AA5A55A5A,
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	0x0FF00FF00FF00FF0,
	0x0F0FF0F00F0FF0F0
},
{
	0x5AA55AA5A55AA55A,
	0x3CC33CC3C33CC33C,
	0xA5A55A5AA5A55A5A,
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	0xF00FF00FF00FF00F,
	0xF0F00F0FF0F00F0F
},
{
	0x5AA55AA5A55AA55A,
	0xC33CC33C3CC33CC3,
	0xA5A55A5AA5A55A5A,
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	0x0FF00FF00FF00FF0,
	0x0F0FF0F00F0FF0F0
},
{
	0xA55AA55A5AA55AA5,
	0xC33CC33C3CC33CC3,
	0xA5A55A5AA5A55A5A,
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	0xF00FF00FF00FF00F,
	0x0F0FF0F00F0FF0F0
},
{
	0xA55AA55A5AA55AA5,
	0x3CC33CC3C33CC33C,
	0xA5A55A5AA5A55A5A,
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	0x0FF00FF00FF00FF0,
	0xF0F00F0FF0F00F0F
},
{
	0xA55AA55A5AA55AA5,
	0x3CC33CC3C33CC33C,
	0xA5A55A5AA5A55A5A,
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	0x0FF00FF00FF00FF0,
	0xF0F00F0FF0F00F0F
},
{
	0xA55AA55A5AA55AA5,
	0xC33CC33C3CC33CC3,
	0xA5A55A5AA5A55A5A,
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	0xF00FF00FF00FF00F,
	0x0F0FF0F00F0FF0F0
},
{
	0x5AA55AA5A55AA55A,
	0xC33CC33C3CC33CC3,
	0xA5A55A5AA5A55A5A,
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	0x0FF00FF00FF00FF0,
	0x0F0FF0F00F0FF0F0
},
{
	0x5AA55AA5A55AA55A,
	0x3CC33CC3C33CC33C,
	0xA5A55A5AA5A55A5A,
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	0xF00FF00FF00FF00F,
	0xF0F00F0FF0F00F0F
},
{
	0x5AA55AA5A55AA55A,
	0xC33CC33C3CC33CC3,
	0xA5A55A5AA5A55A5A,
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	0xF00FF00FF00FF00F,
	0xF0F00F0FF0F00F0F
},
{
	0x5AA55AA5A55AA55A,
	0x3CC33CC3C33CC33C,
	0xA5A55A5AA5A55A5A,
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	0x0FF00FF00FF00FF0,
	0x0F0FF0F00F0FF0F0
},
{
	0xA55AA55A5AA55AA5,
	0x3CC33CC3C33CC33C,
	0xA5A55A5AA5A55A5A,
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	0xF00FF00FF00FF00F,
	0x0F0FF0F00F0FF0F0
},
{
	0xA55AA55A5AA55AA5,
	0xC33CC33C3CC33CC3,
	0xA5A55A5AA5A55A5A,
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	0x0FF00FF00FF00FF0,
	0xF0F00F0FF0F00F0F
},
{
	0xA55AA55A5AA55AA5,
	0xC33CC33C3CC33CC3,
	0xA5A55A5AA5A55A5A,
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	0x0FF00FF00FF00FF0,
	0xF0F00F0FF0F00F0F
},
{
	0xA55AA55A5AA55AA5,
	0x3CC33CC3C33CC33C,
	0xA5A55A5AA5A55A5A,
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	0xF00FF00FF00FF00F,
	0x0F0FF0F00F0FF0F0
},
{
	0x5AA55AA5A55AA55A,
	0x3CC33CC3C33CC33C,
	0xA5A55A5AA5A55A5A,
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	0x0FF00FF00FF00FF0,
	0x0F0FF0F00F0FF0F0
},
{
	0x5AA55AA5A55AA55A,
	0xC33CC33C3CC33CC3,
	0xA5A55A5AA5A55A5A,
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	0xF00FF00FF00FF00F,
	0xF0F00F0FF0F00F0F
},
{
	0xA55AA55A5AA55AA5,
	0x3CC33CC3C33CC33C,
	0xA5A55A5AA5A55A5A,
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	0xF00FF00FF00FF00F,
	0xF0F00F0FF0F00F0F
},
{
	0xA55AA55A5AA55AA5,
	0xC33CC33C3CC33CC3,
	0xA5A55A5AA5A55A5A,
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	0x0FF00FF00FF00FF0,
	0x0F0FF0F00F0FF0F0
},
{
	0x5AA55AA5A55AA55A,
	0xC33CC33C3CC33CC3,
	0xA5A55A5AA5A55A5A,
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	0xF00FF00FF00FF00F,
	0x0F0FF0F00F0FF0F0
},
{
	0x5AA55AA5A55AA55A,
	0x3CC33CC3C33CC33C,
	0xA5A55A5AA5A55A5A,
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	0x0FF00FF00FF00FF0,
	0xF0F00F0FF0F00F0F
},
{
	0x5AA55AA5A55AA55A,
	0x3CC33CC3C33CC33C,
	0xA5A55A5AA5A55A5A,
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	0x0FF00FF00FF00FF0,
	0xF0F00F0FF0F00F0F
},
{
	0x5AA55AA5A55AA55A,
	0xC33CC33C3CC33CC3,
	0xA5A55A5AA5A55A5A,
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	0xF00FF00FF00FF00F,
	0x0F0FF0F00F0FF0F0
},
{
	0xA55AA55A5AA55AA5,
	0xC33CC33C3CC33CC3,
	0xA5A55A5AA5A55A5A,
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	0x0FF00FF00FF00FF0,
	0x0F0FF0F00F0FF0F0
},
{
	0xA55AA55A5AA55AA5,
	0x3CC33CC3C33CC33C,
	0xA5A55A5AA5A55A5A,
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	0xF00FF00FF00FF00F,
	0xF0F00F0FF0F00F0F
},
{
	0xA55AA55A5AA55AA5,
	0xC33CC33C3CC33CC3,
	0xA5A55A5AA5A55A5A,
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	0xF00FF00FF00FF00F,
	0xF0F00F0FF0F00F0F
},
{
	0xA55AA55A5AA55AA5,
	0x3CC33CC3C33CC33C,
	0xA5A55A5AA5A55A5A,
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	0x0FF00FF00FF00FF0,
	0x0F0FF0F00F0FF0F0
},
{
	0x5AA55AA5A55AA55A,
	0x3CC33CC3C33CC33C,
	0xA5A55A5AA5A55A5A,
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	0xF00FF00FF00FF00F,
	0x0F0FF0F00F0FF0F0
},
{
	0x5AA55AA5A55AA55A,
	0xC33CC33C3CC33CC3,
	0xA5A55A5AA5A55A5A,
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	0x0FF00FF00FF00FF0,
	0xF0F00F0FF0F00F0F
},
{
	0x5AA55AA5A55AA55A,
	0xC33CC33C3CC33CC3,
	0xA5A55A5AA5A55A5A,
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	0x0FF00FF00FF00FF0,
	0xF0F00F0FF0F00F0F
},
{
	0x5AA55AA5A55AA55A,
	0x3CC33CC3C33CC33C,
	0xA5A55A5AA5A55A5A,
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	0xF00FF00FF00FF00F,
	0x0F0FF0F00F0FF0F0
},
{
	0xA55AA55A5AA55AA5,
	0x3CC33CC3C33CC33C,
	0xA5A55A5AA5A55A5A,
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	0x0FF00FF00FF00FF0,
	0x0F0FF0F00F0FF0F0
},
{
	0xA55AA55A5AA55AA5,
	0xC33CC33C3CC33CC3,
	0xA5A55A5AA5A55A5A,
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	0xF00FF00FF00FF00F,
	0xF0F00F0FF0F00F0F
},
{
	0xA55AA55A5AA55AA5,
	0x3CC33CC3C33CC33C,
	0xA5A55A5AA5A55A5A,
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	0x0FF00FF00FF00FF0,
	0x0F0FF0F00F0FF0F0
},
{
	0xA55AA55A5AA55AA5,
	0xC33CC33C3CC33CC3,
	0xA5A55A5AA5A55A5A,
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	0xF00FF00FF00FF00F,
	0xF0F00F0FF0F00F0F
},
{
	0x5AA55AA5A55AA55A,
	0xC33CC33C3CC33CC3,
	0xA5A55A5AA5A55A5A,
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	0x0FF00FF00FF00FF0,
	0xF0F00F0FF0F00F0F
},
{
	0x5AA55AA5A55AA55A,
	0x3CC33CC3C33CC33C,
	0xA5A55A5AA5A55A5A,
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	0xF00FF00FF00FF00F,
	0x0F0FF0F00F0FF0F0
},
{
	0x5AA55AA5A55AA55A,
	0x3CC33CC3C33CC33C,
	0xA5A55A5AA5A55A5A,
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	0xF00FF00FF00FF00F,
	0x0F0FF0F00F0FF0F0
},
{
	0x5AA55AA5A55AA55A,
	0xC33CC33C3CC33CC3,
	0xA5A55A5AA5A55A5A,
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	0x0FF00FF00FF00FF0,
	0xF0F00F0FF0F00F0F
},
{
	0xA55AA55A5AA55AA5,
	0xC33CC33C3CC33CC3,
	0xA5A55A5AA5A55A5A,
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	0xF00FF00FF00FF00F,
	0xF0F00F0FF0F00F0F
},
{
	0xA55AA55A5AA55AA5,
	0x3CC33CC3C33CC33C,
	0xA5A55A5AA5A55A5A,
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	0x0FF00FF00FF00FF0,
	0x0F0FF0F00F0FF0F0
},
{
	0xA55AA55A5AA55AA5,
	0xC33CC33C3CC33CC3,
	0xA5A55A5AA5A55A5A,
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	0x0FF00FF00FF00FF0,
	0x0F0FF0F00F0FF0F0
},
{
	0xA55AA55A5AA55AA5,
	0x3CC33CC3C33CC33C,
	0xA5A55A5AA5A55A5A,
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	0xF00FF00FF00FF00F,
	0xF0F00F0FF0F00F0F
},
{
	0x5AA55AA5A55AA55A,
	0x3CC33CC3C33CC33C,
	0xA5A55A5AA5A55A5A,
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	0x0FF00FF00FF00FF0,
	0xF0F00F0FF0F00F0F
},
{
	0x5AA55AA5A55AA55A,
	0xC33CC33C3CC33CC3,
	0xA5A55A5AA5A55A5A,
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	0xF00FF00FF00FF00F,
	0x0F0FF0F00F0FF0F0
},
{
	0x5AA55AA5A55AA55A,
	0xC33CC33C3CC33CC3,
	0xA5A55A5AA5A55A5A,
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	0xF00FF00FF00FF00F,
	0x0F0FF0F00F0FF0F0
},
{
	0x5AA55AA5A55AA55A,
	0x3CC33CC3C33CC33C,
	0xA5A55A5AA5A55A5A,
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	0x0FF00FF00FF00FF0,
	0xF0F00F0FF0F00F0F
},
{
	0xA55AA55A5AA55AA5,
	0x3CC33CC3C33CC33C,
	0xA5A55A5AA5A55A5A,
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	0xF00FF00FF00FF00F,
	0xF0F00F0FF0F00F0F
},
{
	0xA55AA55A5AA55AA5,
	0xC33CC33C3CC33CC3,
	0xA5A55A5AA5A55A5A,
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	0x0FF00FF00FF00FF0,
	0x0F0FF0F00F0FF0F0
},
{
	0xA55AA55A5AA55AA5,
	0x3CC33CC3C33CC33C,
	0xA5A55A5AA5A55A5A,
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	0x0FF00FF00FF00FF0,
	0x0F0FF0F00F0FF0F0
},
{
	0xA55AA55A5AA55AA5,
	0xC33CC33C3CC33CC3,
	0xA5A55A5AA5A55A5A,
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	0xF00FF00FF00FF00F,
	0xF0F00F0FF0F00F0F
},
{
	0x5AA55AA5A55AA55A,
	0xC33CC33C3CC33CC3,
	0xA5A55A5AA5A55A5A,
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	0x0FF00FF00FF00FF0,
	0xF0F00F0FF0F00F0F
},
{
	0x5AA55AA5A55AA55A,
	0x3CC33CC3C33CC33C,
	0xA5A55A5AA5A55A5A,
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	0xF00FF00FF00FF00F,
	0x0F0FF0F00F0FF0F0
},
{
	0x5AA55AA5A55AA55A,
	0x3CC33CC3C33CC33C,
	0xA5A55A5AA5A55A5A,
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	0xF00FF00FF00FF00F,
	0x0F0FF0F00F0FF0F0
},
{
	0x5AA55AA5A55AA55A,
	0xC33CC33C3CC33CC3,
	0xA5A55A5AA5A55A5A,
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	0x0FF00FF00FF00FF0,
	0xF0F00F0FF0F00F0F
},
{
	0xA55AA55A5AA55AA5,
	0xC33CC33C3CC33CC3,
	0xA5A55A5AA5A55A5A,
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	0xF00FF00FF00FF00F,
	0xF0F00F0FF0F00F0F
},
{
	0xA55AA55A5AA55AA5,
	0x3CC33CC3C33CC33C,
	0xA5A55A5AA5A55A5A,
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	0x0FF00FF00FF00FF0,
	0x0F0FF0F00F0FF0F0
},
{
	0xA55AA55A5AA55AA5,
	0xC33CC33C3CC33CC3,
	0xA5A55A5AA5A55A5A,
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	0x0FF00FF00FF00FF0,
	0x0F0FF0F00F0FF0F0
},
{
	0xA55AA55A5AA55AA5,
	0x3CC33CC3C33CC33C,
	0xA5A55A5AA5A55A5A,
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	0xF00FF00FF00FF00F,
	0xF0F00F0FF0F00F0F
},
{
	0x5AA55AA5A55AA55A,
	0x3CC33CC3C33CC33C,
	0xA5A55A5AA5A55A5A,
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	0x0FF00FF00FF00FF0,
	0xF0F00F0FF0F00F0F
},
{
	0x5AA55AA5A55AA55A,
	0xC33CC33C3CC33CC3,
	0xA5A55A5AA5A55A5A,
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	0xF00FF00FF00FF00F,
	0x0F0FF0F00F0FF0F0
},
{
	0x5AA55AA5A55AA55A,
	0xC33CC33C3CC33CC3,
	0xA5A55A5AA5A55A5A,
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	0xF00FF00FF00FF00F,
	0x0F0FF0F00F0FF0F0
},
{
	0x5AA55AA5A55AA55A,
	0x3CC33CC3C33CC33C,
	0xA5A55A5AA5A55A5A,
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	0x0FF00FF00FF00FF0,
	0xF0F00F0FF0F00F0F
},
{
	0xA55AA55A5AA55AA5,
	0x3CC33CC3C33CC33C,
	0xA5A55A5AA5A55A5A,
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	0xF00FF00FF00FF00F,
	0xF0F00F0FF0F00F0F
},
{
	0xA55AA55A5AA55AA5,
	0xC33CC33C3CC33CC3,
	0xA5A55A5AA5A55A5A,
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	0x0FF00FF00FF00FF0,
	0x0F0FF0F00F0FF0F0
},
{
	0xA55AA55A5AA55AA5,
	0x3CC33CC3C33CC33C,
	0xA5A55A5AA5A55A5A,
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	0xF00FF00FF00FF00F,
	0xF0F00F0FF0F00F0F
},
{
	0xA55AA55A5AA55AA5,
	0xC33CC33C3CC33CC3,
	0xA5A55A5AA5A55A5A,
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	0x0FF00FF00FF00FF0,
	0x0F0FF0F00F0FF0F0
},
{
	0x5AA55AA5A55AA55A,
	0xC33CC33C3CC33CC3,
	0xA5A55A5AA5A55A5A,
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	0xF00FF00FF00FF00F,
	0x0F0FF0F00F0FF0F0
},
{
	0x5AA55AA5A55AA55A,
	0x3CC33CC3C33CC33C,
	0xA5A55A5AA5A55A5A,
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	0x0FF00FF00FF00FF0,
	0xF0F00F0FF0F00F0F
},
{
	0x5AA55AA5A55AA55A,
	0x3CC33CC3C33CC33C,
	0xA5A55A5AA5A55A5A,
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	0x0FF00FF00FF00FF0,
	0xF0F00F0FF0F00F0F
},
{
	0x5AA55AA5A55AA55A,
	0xC33CC33C3CC33CC3,
	0xA5A55A5AA5A55A5A,
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	0xF00FF00FF00FF00F,
	0x0F0FF0F00F0FF0F0
},
{
	0xA55AA55A5AA55AA5,
	0xC33CC33C3CC33CC3,
	0xA5A55A5AA5A55A5A,
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	0x0FF00FF00FF00FF0,
	0x0F0FF0F00F0FF0F0
},
{
	0xA55AA55A5AA55AA5,
	0x3CC33CC3C33CC33C,
	0xA5A55A5AA5A55A5A,
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	0xF00FF00FF00FF00F,
	0xF0F00F0FF0F00F0F
},
{
	0xA55AA55A5AA55AA5,
	0xC33CC33C3CC33CC3,
	0xA5A55A5AA5A55A5A,
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	0xF00FF00FF00FF00F,
	0xF0F00F0FF0F00F0F
},
{
	0xA55AA55A5AA55AA5,
	0x3CC33CC3C33CC33C,
	0xA5A55A5AA5A55A5A,
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	0x0FF00FF00FF00FF0,
	0x0F0FF0F00F0FF0F0
},
{
	0x5AA55AA5A55AA55A,
	0x3CC33CC3C33CC33C,
	0xA5A55A5AA5A55A5A,
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	0xF00FF00FF00FF00F,
	0x0F0FF0F00F0FF0F0
},
{
	0x5AA55AA5A55AA55A,
	0xC33CC33C3CC33CC3,
	0xA5A55A5AA5A55A5A,
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	0x0FF00FF00FF00FF0,
	0xF0F00F0FF0F00F0F
},
{
	0x5AA55AA5A55AA55A,
	0xC33CC33C3CC33CC3,
	0xA5A55A5AA5A55A5A,
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	0x0FF00FF00FF00FF0,
	0xF0F00F0FF0F00F0F
},
{
	0x5AA55AA5A55AA55A,
	0x3CC33CC3C33CC33C,
	0xA5A55A5AA5A55A5A,
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	0xF00FF00FF00FF00F,
	0x0F0FF0F00F0FF0F0
},
{
	0xA55AA55A5AA55AA5,
	0x3CC33CC3C33CC33C,
	0xA5A55A5AA5A55A5A,
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	0x0FF00FF00FF00FF0,
	0x0F0FF0F00F0FF0F0
},
{
	0xA55AA55A5AA55AA5,
	0xC33CC33C3CC33CC3,
	0xA5A55A5AA5A55A5A,
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	0xF00FF00FF00FF00F,
	0xF0F00F0FF0F00F0F
},
{
	0x5AA55AA5A55AA55A,
	0x3CC33CC3C33CC33C,
	0xA5A55A5AA5A55A5A,
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	0xF00FF00FF00FF00F,
	0xF0F00F0FF0F00F0F
},
{
	0x5AA55AA5A55AA55A,
	0xC33CC33C3CC33CC3,
	0xA5A55A5AA5A55A5A,
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	0x0FF00FF00FF00FF0,
	0x0F0FF0F00F0FF0F0
},
{
	0xA55AA55A5AA55AA5,
	0xC33CC33C3CC33CC3,
	0xA5A55A5AA5A55A5A,
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	0xF00FF00FF00FF00F,
	0x0F0FF0F00F0FF0F0
},
{
	0xA55AA55A5AA55AA5,
	0x3CC33CC3C33CC33C,
	0xA5A55A5AA5A55A5A,
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	0x0FF00FF00FF00FF0,
	0xF0F00F0FF0F00F0F
},
{
	0xA55AA55A5AA55AA5,
	0x3CC33CC3C33CC33C,
	0xA5A55A5AA5A55A5A,
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	0x0FF00FF00FF00FF0,
	0xF0F00F0FF0F00F0F
},
{
	0xA55AA55A5AA55AA5,
	0xC33CC33C3CC33CC3,
	0xA5A55A5AA5A55A5A,
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	0xF00FF00FF00FF00F,
	0x0F0FF0F00F0FF0F0
},
{
	0x5AA55AA5A55AA55A,
	0xC33CC33C3CC33CC3,
	0xA5A55A5AA5A55A5A,
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	0x0FF00FF00FF00FF0,
	0x0F0FF0F00F0FF0F0
},
{
	0x5AA55AA5A55AA55A,
	0x3CC33CC3C33CC33C,
	0xA5A55A5AA5A55A5A,
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	0xF00FF00FF00FF00F,
	0xF0F00F0FF0F00F0F
},
{
	0x5AA55AA5A55AA55A,
	0xC33CC33C3CC33CC3,
	0xA5A55A5AA5A55A5A,
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	0xF00FF00FF00FF00F,
	0xF0F00F0FF0F00F0F
},
{
	0x5AA55AA5A55AA55A,
	0x3CC33CC3C33CC33C,
	0xA5A55A5AA5A55A5A,
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	0x0FF00FF00FF00FF0,
	0x0F0FF0F00F0FF0F0
},
{
	0xA55AA55A5AA55AA5,
	0x3CC33CC3C33CC33C,
	0xA5A55A5AA5A55A5A,
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	0xF00FF00FF00FF00F,
	0x0F0FF0F00F0FF0F0
},
{
	0xA55AA55A5AA55AA5,
	0xC33CC33C3CC33CC3,
	0xA5A55A5AA5A55A5A,
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	0x0FF00FF00FF00FF0,
	0xF0F00F0FF0F00F0F
},
{
	0xA55AA55A5AA55AA5,
	0xC33CC33C3CC33CC3,
	0xA5A55A5AA5A55A5A,
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	0x0FF00FF00FF00FF0,
	0xF0F00F0FF0F00F0F
},
{
	0xA55AA55A5AA55AA5,
	0x3CC33CC3C33CC33C,
	0xA5A55A5AA5A55A5A,
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	0xF00FF00FF00FF00F,
	0x0F0FF0F00F0FF0F0
},
{
	0x5AA55AA5A55AA55A,
	0x3CC33CC3C33CC33C,
	0xA5A55A5AA5A55A5A,
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	0x0FF00FF00FF00FF0,
	0x0F0FF0F00F0FF0F0
},
{
	0x5AA55AA5A55AA55A,
	0xC33CC33C3CC33CC3,
	0xA5A55A5AA5A55A5A,
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	0xF00FF00FF00FF00F,
	0xF0F00F0FF0F00F0F
},
{
	0x5AA55AA5A55AA55A,
	0x3CC33CC3C33CC33C,
	0xA5A55A5AA5A55A5A,
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	0x0FF00FF00FF00FF0,
	0x0F0FF0F00F0FF0F0
},
{
	0x5AA55AA5A55AA55A,
	0xC33CC33C3CC33CC3,
	0xA5A55A5AA5A55A5A,
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	0xF00FF00FF00FF00F,
	0xF0F00F0FF0F00F0F
},
{
	0xA55AA55A5AA55AA5,
	0xC33CC33C3CC33CC3,
	0xA5A55A5AA5A55A5A,
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	0x0FF00FF00FF00FF0,
	0xF0F00F0FF0F00F0F
},
{
	0xA55AA55A5AA55AA5,
	0x3CC33CC3C33CC33C,
	0xA5A55A5AA5A55A5A,
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	0xF00FF00FF00FF00F,
	0x0F0FF0F00F0FF0F0
},
{
	0xA55AA55A5AA55AA5,
	0x3CC33CC3C33CC33C,
	0xA5A55A5AA5A55A5A,
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	0xF00FF00FF00FF00F,
	0x0F0FF0F00F0FF0F0
},
{
	0xA55AA55A5AA55AA5,
	0xC33CC33C3CC33CC3,
	0xA5A55A5AA5A55A5A,
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	0x0FF00FF00FF00FF0,
	0xF0F00F0FF0F00F0F
},
{
	0x5AA55AA5A55AA55A,
	0xC33CC33C3CC33CC3,
	0xA5A55A5AA5A55A5A,
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	0xF00FF00FF00FF00F,
	0xF0F00F0FF0F00F0F
},
{
	0x5AA55AA5A55AA55A,
	0x3CC33CC3C33CC33C,
	0xA5A55A5AA5A55A5A,
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	0x0FF00FF00FF00FF0,
	0x0F0FF0F00F0FF0F0
},
{
	0x5AA55AA5A55AA55A,
	0xC33CC33C3CC33CC3,
	0xA5A55A5AA5A55A5A,
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	0x0FF00FF00FF00FF0,
	0x0F0FF0F00F0FF0F0
},
{
	0x5AA55AA5A55AA55A,
	0x3CC33CC3C33CC33C,
	0xA5A55A5AA5A55A5A,
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	0xF00FF00FF00FF00F,
	0xF0F00F0FF0F00F0F
},
{
	0xA55AA55A5AA55AA5,
	0x3CC33CC3C33CC33C,
	0xA5A55A5AA5A55A5A,
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	0x0FF00FF00FF00FF0,
	0xF0F00F0FF0F00F0F
},
{
	0xA55AA55A5AA55AA5,
	0xC33CC33C3CC33CC3,
	0xA5A55A5AA5A55A5A,
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	0xF00FF00FF00FF00F,
	0x0F0FF0F00F0FF0F0
},
{
	0xA55AA55A5AA55AA5,
	0xC33CC33C3CC33CC3,
	0xA5A55A5AA5A55A5A,
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	0xF00FF00FF00FF00F,
	0x0F0FF0F00F0FF0F0
},
{
	0xA55AA55A5AA55AA5,
	0x3CC33CC3C33CC33C,
	0xA5A55A5AA5A55A5A,
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	0x0FF00FF00FF00FF0,
	0xF0F00F0FF0F00F0F
},
{
	0x5AA55AA5A55AA55A,
	0x3CC33CC3C33CC33C,
	0xA5A55A5AA5A55A5A,
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	0xF00FF00FF00FF00F,
	0xF0F00F0FF0F00F0F
},
{
	0x5AA55AA5A55AA55A,
	0xC33CC33C3CC33CC3,
	0xA5A55A5AA5A55A5A,
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	0x0FF00FF00FF00FF0,
	0x0F0FF0F00F0FF0F0
}

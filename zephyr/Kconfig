## zephyr/Kconfig
```kconfig
# SPDX-License-Identifier: MIT

config LIBOQS
	bool "Enable liboqs"
	depends on ARM || ARM64 || X86 || ARCH_POSIX || RISCV
	help
	  This option enables the liboqs as a Zephyr module. Currenty, the port is only
	  available for ARM, ARM64, x86, RISCV-32, and RISCV-64 architectures and the native Posix simulators.

menu "Liboqs algorithm configuration"

config LIBOQS_ENABLE_KEM_BIKE
	bool "Enable the BIKE KEM algorithm"
	default n
	depends on LIBOQS
	help
	  This option enables the BIKE KEM algorithm.

config LIBOQS_ENABLE_KEM_FRODOKEM
	bool "Enable the FRODOKEM KEM algorithm"
	default n
	depends on LIBOQS

config LIBOQS_ENABLE_KEM_NTRUPRIME
	bool "Enable the NRTUPRIME KEM algorithm"
	default n
	depends on LIBOQS

config LIBOQS_ENABLE_KEM_CLASSIC_MCELIECE
	bool "Enable the CLASSIC_MCELIECE KEM algorithm"
	default n
	depends on LIBOQS

config LIBOQS_ENABLE_KEM_HQC
	bool "Enable the HQC KEM algorithm"
	default n
	depends on LIBOQS

config LIBOQS_ENABLE_KEM_KYBER
	bool "Enable the KYBER KEM algorithm (NIST Round 3)"
	default n
	depends on LIBOQS

config LIBOQS_ENABLE_KEM_ML_KEM
	bool "Enable the ML-KEM algorithm (ML-KEM)"
	default y
	depends on LIBOQS

config LIBOQS_ENABLE_SIG_ML_DSA
	bool "Enable the ML-DSA signature algorithm (ML-DSA)"
	default y
	depends on LIBOQS

config LIBOQS_ENABLE_SIG_FALCON
	bool "Enable the FALCON signature algorithm"
	default y
	depends on LIBOQS

config LIBOQS_ENABLE_SIG_MAYO
	bool "Enable the MAYO signature algorithm"
	default y
	depends on LIBOQS

config LIBOQS_ENABLE_SIG_CROSS
	bool "Enable the CROSS signature algorithm"
	default y
	depends on LIBOQS

config LIBOQS_ENABLE_SIG_UOV
	bool "Enable the UOV signature algorithm"
	default n
	depends on LIBOQS

config LIBOQS_ENABLE_SIG_SNOVA
	bool "Enable the SNOVA signature algorithm"
	default y
	depends on LIBOQS

endmenu
```
